## main/Kconfig.projbuild
```kconfig
menu "Trợ lý Xiaozhi"

config OTA_URL
    string "URL OTA mặc định"
    default "https://api.tenclass.net/xiaozhi/ota/"
    help
        Ứng dụng sẽ truy cập URL này để kiểm tra firmware mới và địa chỉ server.

choice
    prompt "Nạp tài nguyên Flash"
    default FLASH_DEFAULT_ASSETS if !USE_EMOTE_MESSAGE_STYLE
    default FLASH_EXPRESSION_ASSETS if USE_EMOTE_MESSAGE_STYLE
    help
        Chọn tài nguyên cần nạp vào flash.

    config FLASH_NONE_ASSETS
        bool "Không nạp tài nguyên"
    config FLASH_DEFAULT_ASSETS
        bool "Nạp tài nguyên mặc định"
        depends on !USE_EMOTE_MESSAGE_STYLE
    config FLASH_CUSTOM_ASSETS
        bool "Nạp tài nguyên tùy chỉnh"
    config FLASH_EXPRESSION_ASSETS
        bool "Nạp tài nguyên biểu cảm"
        depends on USE_EMOTE_MESSAGE_STYLE
endchoice

config CUSTOM_ASSETS_FILE
    depends on FLASH_CUSTOM_ASSETS
    string "Tệp tài nguyên tùy chỉnh"
    default "assets.bin"
    help
        Tệp tài nguyên tùy chỉnh cần nạp vào flash.
        Có thể là tệp cục bộ (đường dẫn tương đối so với thư mục dự án) hoặc URL từ xa.

choice
    prompt "Ngôn ngữ mặc định"
    default LANGUAGE_ZH_CN
    help
        Chọn ngôn ngữ hiển thị của thiết bị

    config LANGUAGE_ZH_CN
        bool "Tiếng Trung (Giản thể)"
    config LANGUAGE_ZH_TW
        bool "Tiếng Trung (Phồn thể)"
    config LANGUAGE_EN_US
        bool "Tiếng Anh"
    config LANGUAGE_JA_JP
        bool "Tiếng Nhật"
    config LANGUAGE_KO_KR
        bool "Tiếng Hàn"
    config LANGUAGE_VI_VN
        bool "Tiếng Việt"
    config LANGUAGE_TH_TH
        bool "Tiếng Thái"
    config LANGUAGE_DE_DE
        bool "Tiếng Đức"
    config LANGUAGE_FR_FR
        bool "Tiếng Pháp"
    config LANGUAGE_ES_ES
        bool "Tiếng Tây Ban Nha"
    config LANGUAGE_IT_IT
        bool "Tiếng Ý"
    config LANGUAGE_RU_RU
        bool "Tiếng Nga"
    config LANGUAGE_AR_SA
        bool "Tiếng Ả Rập"
    config LANGUAGE_HI_IN
        bool "Tiếng Hindi"
    config LANGUAGE_PT_PT
        bool "Tiếng Bồ Đào Nha"
    config LANGUAGE_PL_PL
        bool "Tiếng Ba Lan"
    config LANGUAGE_CS_CZ
        bool "Tiếng Séc"
    config LANGUAGE_FI_FI
        bool "Tiếng Phần Lan"
    config LANGUAGE_TR_TR
        bool "Tiếng Thổ Nhĩ Kỳ"
    config LANGUAGE_ID_ID
        bool "Tiếng Indonesia"
    config LANGUAGE_UK_UA
        bool "Tiếng Ukraine"
    config LANGUAGE_RO_RO
        bool "Tiếng Romania"
    config LANGUAGE_BG_BG
        bool "Tiếng Bulgaria"
    config LANGUAGE_CA_ES
        bool "Tiếng Catalan"
    config LANGUAGE_DA_DK
        bool "Tiếng Đan Mạch"
    config LANGUAGE_EL_GR
        bool "Tiếng Hy Lạp"
    config LANGUAGE_FA_IR
        bool "Tiếng Ba Tư"
    config LANGUAGE_FIL_PH
        bool "Tiếng Philippines"
    config LANGUAGE_HE_IL
        bool "Tiếng Do Thái"
    config LANGUAGE_HR_HR
        bool "Tiếng Croatia"
    config LANGUAGE_HU_HU
        bool "Tiếng Hungary"
    config LANGUAGE_MS_MY
        bool "Tiếng Mã Lai"
    config LANGUAGE_NB_NO
        bool "Tiếng Na Uy"
    config LANGUAGE_NL_NL
        bool "Tiếng Hà Lan"
    config LANGUAGE_SK_SK
        bool "Tiếng Slovak"
    config LANGUAGE_SL_SI
        bool "Tiếng Slovenia"
    config LANGUAGE_SV_SE
        bool "Tiếng Thụy Điển"
    config LANGUAGE_SR_RS
        bool "Tiếng Serbia"
endchoice

choice BOARD_TYPE
    prompt "Loại bo mạch"
    default BOARD_TYPE_BREAD_COMPACT_WIFI
    help
        Loại bo mạch phát triển.
    config BOARD_TYPE_BREAD_COMPACT_WIFI
        bool "Bread Compact WiFi (Breadboard)"
        depends on IDF_TARGET_ESP32S3
    config BOARD_TYPE_BREAD_COMPACT_WIFI_LCD
        bool "Bread Compact WiFi + LCD (Breadboard)"
        depends on IDF_TARGET_ESP32S3
    config BOARD_TYPE_BREAD_COMPACT_WIFI_CAM
        bool "Bread Compact WiFi + LCD + Camera (Breadboard)"
        depends on IDF_TARGET_ESP32S3
    config BOARD_TYPE_BREAD_COMPACT_ML307
        bool "Bread Compact ML307/EC801E (Breadboard 4G)"
        depends on IDF_TARGET_ESP32S3
    config BOARD_TYPE_BREAD_COMPACT_NT26
        bool "Bread Compact NT26 (Breadboard 4G)"
        depends on IDF_TARGET_ESP32S3
    config BOARD_TYPE_BREAD_COMPACT_ESP32
        bool "Bread Compact ESP32 DevKit (Breadboard)"
        depends on IDF_TARGET_ESP32
    config BOARD_TYPE_BREAD_COMPACT_ESP32_LCD
        bool "Bread Compact ESP32 DevKit + LCD (Breadboard)"
        depends on IDF_TARGET_ESP32
    config BOARD_TYPE_XMINI_C3_V3
        bool "Xmini C3 V3"
        depends on IDF_TARGET_ESP32C3
    config BOARD_TYPE_XMINI_C3_4G
        bool "Xmini C3 4G"
        depends on IDF_TARGET_ESP32C3
    config BOARD_TYPE_XMINI_C3
        bool "Xmini C3"
        depends on IDF_TARGET_ESP32C3
    config BOARD_TYPE_ESP_KORVO2_V3
        bool "Espressif Korvo2 V3"
        depends on IDF_TARGET_ESP32S3
    config BOARD_TYPE_ESP_KORVO2_V3_RNDIS
        bool "Espressif Korvo2 V3 RNDIS"
        depends on IDF_TARGET_ESP32S3
    config BOARD_TYPE_ESP_SPARKBOT
        bool "Espressif SparkBot"
        depends on IDF_TARGET_ESP32S3
    config BOARD_TYPE_ESP_SENSAIRSHUTTLE
        bool "Espressif ESP-SensairShuttle"
        depends on IDF_TARGET_ESP32C5
    config BOARD_TYPE_ESP_SPOT_S3
        bool "Espressif Spot-S3"
        depends on IDF_TARGET_ESP32S3
    config BOARD_TYPE_ESP_SPOT_C5
        bool "Espressif Spot-C5"
        depends on IDF_TARGET_ESP32C5
    config BOARD_TYPE_ESP_HI
        bool "Espressif ESP-HI"
        depends on IDF_TARGET_ESP32C3
    config BOARD_TYPE_ESP_BOX_3
        bool "Espressif ESP-BOX-3"
        depends on IDF_TARGET_ESP32S3
    config BOARD_TYPE_ESP_BOX
        bool "Espressif ESP-BOX"
        depends on IDF_TARGET_ESP32S3
    config BOARD_TYPE_ESP_BOX_LITE
        bool "Espressif ESP-BOX-Lite"
        depends on IDF_TARGET_ESP32S3
    config BOARD_TYPE_ESP_P4_FUNCTION_EV_BOARD
        bool "Espressif ESP-P4-Function-EV-Board"
        depends on IDF_TARGET_ESP32P4
    config BOARD_TYPE_ESP_VOCAT
        bool "Espressif ESP-VoCat"
        depends on IDF_TARGET_ESP32S3
    config BOARD_TYPE_KEVIN_BOX_2
        bool "Kevin Box 2"
        depends on IDF_TARGET_ESP32S3
    config BOARD_TYPE_KEVIN_C3
        bool "Kevin C3"
        depends on IDF_TARGET_ESP32C3
    config BOARD_TYPE_KEVIN_SP_V3_DEV
        bool "Kevin SP V3"
        depends on IDF_TARGET_ESP32S3
    config BOARD_TYPE_KEVIN_SP_V4_DEV
        bool "Kevin SP V4"
        depends on IDF_TARGET_ESP32S3
    config BOARD_TYPE_KEVIN_YUYING_313LCD
        bool "鱼鹰科技 3.13LCD"
        depends on IDF_TARGET_ESP32S3
    config BOARD_TYPE_CGC
        bool "CGC"
        depends on IDF_TARGET_ESP32
    config BOARD_TYPE_CGC_144
        bool "CGC 144"
        depends on IDF_TARGET_ESP32
    config BOARD_TYPE_LICHUANG_DEV_S3
        bool "立创·实战派 ESP32-S3"
        depends on IDF_TARGET_ESP32S3
    config BOARD_TYPE_LICHUANG_DEV_C3
        bool "立创·实战派 ESP32-C3"
        depends on IDF_TARGET_ESP32C3
    config BOARD_TYPE_RYMCU_BIGSMART
        bool "RYMCU BigSmart"
        depends on IDF_TARGET_ESP32S3
    config BOARD_TYPE_EDA_TV_PRO
        bool "EDA课程案例 EDA-TV-Pro"
        depends on IDF_TARGET_ESP32S3
    config BOARD_TYPE_EDA_ROBOT_PRO
        bool "EDA课程案例 EDA-Robot-Pro"
        depends on IDF_TARGET_ESP32S3
    config BOARD_TYPE_EDA_SUPER_BEAR
        bool "EDA课程案例 EDA-Super-Bear"
        depends on IDF_TARGET_ESP32S3
    config BOARD_TYPE_DF_K10
        bool "DFRobot 行空板 k10"
        depends on IDF_TARGET_ESP32S3
    config BOARD_TYPE_DF_S3_AI_CAM
        bool "DFRobot ESP32-S3 AI智能摄像头模块"
        depends on IDF_TARGET_ESP32S3
    config BOARD_TYPE_MAGICLICK_S3_2P4
        bool "神奇按钮 Magiclick_2.4"
        depends on IDF_TARGET_ESP32S3
    config BOARD_TYPE_MAGICLICK_S3_2P5
        bool "神奇按钮 Magiclick_2.5"
        depends on IDF_TARGET_ESP32S3
    config BOARD_TYPE_MAGICLICK_C3
        bool "神奇按钮 Magiclick_C3"
        depends on IDF_TARGET_ESP32C3
    config BOARD_TYPE_MAGICLICK_C3_V2
        bool "神奇按钮 Magiclick_C3_v2"
        depends on IDF_TARGET_ESP32C3
    config BOARD_TYPE_M5STACK_CORE_S3
        bool "M5Stack CoreS3"
        depends on IDF_TARGET_ESP32S3
    config BOARD_TYPE_M5STACK_CORE_TAB5
        bool "M5Stack Tab5"
        depends on IDF_TARGET_ESP32P4
    config BOARD_TYPE_M5STACK_ATOM_S3_ECHO_BASE
        bool "M5Stack AtomS3 + Echo Base"
        depends on IDF_TARGET_ESP32S3
    config BOARD_TYPE_M5STACK_ATOM_S3R_ECHO_BASE
        bool "M5Stack AtomS3R + Echo Base"
        depends on IDF_TARGET_ESP32S3
    config BOARD_TYPE_M5STACK_ATOM_S3R_ECHO_PYRAMID
        bool "M5Stack AtomS3R + Echo Pyramid"
        depends on IDF_TARGET_ESP32S3
    config BOARD_TYPE_M5STACK_ATOM_S3R_CAM_M12_ECHO_BASE
        bool "M5Stack AtomS3R CAM/M12 + Echo Base"
        depends on IDF_TARGET_ESP32S3
    config BOARD_TYPE_M5STACK_ATOM_ECHOS3R
        bool "M5Stack AtomEchoS3R"
        depends on IDF_TARGET_ESP32S3
    config BOARD_TYPE_M5STACK_CARDPUTER_ADV
        bool "M5Stack Cardputer Adv"
        depends on IDF_TARGET_ESP32S3
    config BOARD_TYPE_M5STACK_ATOM_MATRIX_ECHO_BASE
        bool "M5Stack AtomMatrix + Echo Base"
        depends on IDF_TARGET_ESP32
    config BOARD_TYPE_WAVESHARE_ESP32_TOUCH_LCD_3_5
        bool "Waveshare ESP32-Touch-LCD-3.5"
        depends on IDF_TARGET_ESP32
    config BOARD_TYPE_WAVESHARE_ESP32_S3_CAM_XXXX
        bool "Waveshare ESP32-S3-CAM"
        depends on IDF_TARGET_ESP32S3
    config BOARD_TYPE_WAVESHARE_ESP32_S3_AUDIO_BOARD
        bool "Waveshare ESP32-S3-Audio-Board"
        depends on IDF_TARGET_ESP32S3
    config BOARD_TYPE_WAVESHARE_ESP32_S3_TOUCH_AMOLED_1_8
        bool "Waveshare ESP32-S3-Touch-AMOLED-1.8"
        depends on IDF_TARGET_ESP32S3
    config BOARD_TYPE_WAVESHARE_ESP32_S3_TOUCH_AMOLED_1_43C
        bool "Waveshare ESP32-S3-Touch-AMOLED-1.43C"
        depends on IDF_TARGET_ESP32S3
    config BOARD_TYPE_WAVESHARE_ESP32_S3_TOUCH_AMOLED_2_06
        bool "Waveshare ESP32-S3-Touch-AMOLED-2.06"
        depends on IDF_TARGET_ESP32S3
    config BOARD_TYPE_WAVESHARE_ESP32_C6_TOUCH_AMOLED_2_06
        bool "Waveshare ESP32-C6-Touch-AMOLED-2.06"
        depends on IDF_TARGET_ESP32C6
    config BOARD_TYPE_WAVESHARE_ESP32_C6_TOUCH_AMOLED_2_16
        bool "Waveshare ESP32-C6-Touch-AMOLED-2.16"
        depends on IDF_TARGET_ESP32C6
    config BOARD_TYPE_WAVESHARE_ESP32_S3_TOUCH_AMOLED_2_16
        bool "Waveshare ESP32-S3-Touch-AMOLED-2.16"
        depends on IDF_TARGET_ESP32S3
    config BOARD_TYPE_WAVESHARE_ESP32_S3_TOUCH_AMOLED_1_75
        bool "Waveshare ESP32-S3-Touch-AMOLED-1.75"
        depends on IDF_TARGET_ESP32S3
    config BOARD_TYPE_WAVESHARE_ESP32_S3_TOUCH_AMOLED_1_75C
        bool "Waveshare ESP32-S3-Touch-AMOLED-1.75C"
        depends on IDF_TARGET_ESP32S3
    config BOARD_TYPE_WAVESHARE_ESP32_S3_TOUCH_LCD_1_83
        bool "Waveshare ESP32-S3-Touch-LCD-1.83"
        depends on IDF_TARGET_ESP32S3
    config BOARD_TYPE_WAVESHARE_ESP32_S3_TOUCH_LCD_4B
        bool "Waveshare ESP32-S3-Touch-LCD-4B"
        depends on IDF_TARGET_ESP32S3
    config BOARD_TYPE_WAVESHARE_ESP32_S3_TOUCH_LCD_4_3C
        bool "Waveshare ESP32-S3-Touch-LCD-4.3C"
        depends on IDF_TARGET_ESP32S3
    config BOARD_TYPE_WAVESHARE_ESP32_S3_TOUCH_LCD_1_85C
        bool "Waveshare ESP32-S3-Touch-LCD-1.85C"
        depends on IDF_TARGET_ESP32S3
    config BOARD_TYPE_WAVESHARE_ESP32_S3_TOUCH_LCD_1_85
        bool "Waveshare ESP32-S3-Touch-LCD-1.85"
        depends on IDF_TARGET_ESP32S3
    config BOARD_TYPE_WAVESHARE_ESP32_S3_TOUCH_LCD_1_46
        bool "Waveshare ESP32-S3-Touch-LCD-1.46"
        depends on IDF_TARGET_ESP32S3
    config BOARD_TYPE_WAVESHARE_ESP32_C6_LCD_1_69
        bool "Waveshare ESP32-C6-LCD-1.69"
        depends on IDF_TARGET_ESP32C6
    config BOARD_TYPE_WAVESHARE_ESP32_C6_TOUCH_LCD_1_83
        bool "Waveshare ESP32-C6-Touch-LCD-1.83"
        depends on IDF_TARGET_ESP32C6
    config BOARD_TYPE_WAVESHARE_ESP32_C6_TOUCH_AMOLED_1_43
        bool "Waveshare ESP32-C6-Touch-AMOLOED-1.43"
        depends on IDF_TARGET_ESP32C6
    config BOARD_TYPE_WAVESHARE_ESP32_C6_TOUCH_AMOLED_1_32
        bool "Waveshare ESP32-C6-Touch-AMOLOED-1.32"
        depends on IDF_TARGET_ESP32C6
    config BOARD_TYPE_WAVESHARE_ESP32_C6_TOUCH_AMOLED_1_8
        bool "Waveshare ESP32-C6-Touch-AMOLED-1.8"
        depends on IDF_TARGET_ESP32C6
    config BOARD_TYPE_WAVESHARE_ESP32_S3_TOUCH_AMOLED_1_32
        bool "Waveshare ESP32-S3-Touch-AMOLOED-1.32"
        depends on IDF_TARGET_ESP32S3
    config BOARD_TYPE_WAVESHARE_ESP32_S3_TOUCH_LCD_3_49
        bool "Waveshare ESP32-S3-Touch-LCD-3.49"
        depends on IDF_TARGET_ESP32S3
    config BOARD_TYPE_WAVESHARE_ESP32_S3_TOUCH_LCD_3_5
        bool "Waveshare ESP32-S3-Touch-LCD-3.5"
        depends on IDF_TARGET_ESP32S3
    config BOARD_TYPE_WAVESHARE_ESP32_S3_ePaper_1_54_v1
        bool "Waveshare ESP32-S3-ePaper-1.54_v1"
        depends on IDF_TARGET_ESP32S3
    config BOARD_TYPE_WAVESHARE_ESP32_S3_ePaper_1_54_v2
        bool "Waveshare ESP32-S3-ePaper-1.54_v2"
        depends on IDF_TARGET_ESP32S3
    config BOARD_TYPE_WAVESHARE_ESP32_S3_ePaper_3_97
        bool "Waveshare ESP32-S3-ePaper-3.97"
        depends on IDF_TARGET_ESP32S3
    config BOARD_TYPE_WAVESHARE_ESP32_S3_RLCD_4_2
        bool "Waveshare ESP32-S3-RLCD-4.2"
        depends on IDF_TARGET_ESP32S3
    config BOARD_TYPE_WAVESHARE_ESP32_S3_TOUCH_LCD_3_5B
        bool "Waveshare ESP32-S3-Touch-LCD-3.5B"
        depends on IDF_TARGET_ESP32S3
    config BOARD_TYPE_WAVESHARE_ESP32_S3_TOUCH_LCD_1_54
        bool "Waveshare ESP32-S3-Touch-LCD-1.54"
        depends on IDF_TARGET_ESP32S3
    config BOARD_TYPE_WAVESHARE_ESP32_S3_LCD_0_85
        bool "Waveshare ESP32-S3-LCD-0.85"
        depends on IDF_TARGET_ESP32S3
    config BOARD_TYPE_WAVESHARE_ESP32_P4_NANO
        bool "Waveshare ESP32-P4-NANO"
        depends on IDF_TARGET_ESP32P4
    config BOARD_TYPE_WAVESHARE_ESP32_P4_WIFI6_TOUCH_LCD_4B
        bool "Waveshare ESP32-P4-WIFI6-Touch-LCD-4B"
        depends on IDF_TARGET_ESP32P4
    config BOARD_TYPE_WAVESHARE_ESP32_P4_WIFI6_TOUCH_LCD_4_3
        bool "Waveshare ESP32-P4-WIFI6-Touch-LCD-4.3"
        depends on IDF_TARGET_ESP32P4
    config BOARD_TYPE_WAVESHARE_ESP32_P4_WIFI6_TOUCH_LCD_7B
        bool "Waveshare ESP32-P4-WIFI6-Touch-LCD-7B"
        depends on IDF_TARGET_ESP32P4
    config BOARD_TYPE_WAVESHARE_ESP32_P4_WIFI6_TOUCH_LCD_3_4C
        bool "Waveshare ESP32-P4-WIFI6-Touch-LCD-3.4C"
        depends on IDF_TARGET_ESP32P4
    config BOARD_TYPE_WAVESHARE_ESP32_P4_WIFI6_TOUCH_LCD_3_5
        bool "Waveshare ESP32-P4-WIFI6-Touch-LCD-3.5"
        depends on IDF_TARGET_ESP32P4
    config BOARD_TYPE_WAVESHARE_ESP32_P4_WIFI6_TOUCH_LCD_4C
        bool "Waveshare ESP32-P4-WIFI6-Touch-LCD-4C"
        depends on IDF_TARGET_ESP32P4
    config BOARD_TYPE_WAVESHARE_ESP32_P4_WIFI6_TOUCH_LCD_7
        bool "Waveshare ESP32-P4-WIFI6-Touch-LCD-7"
        depends on IDF_TARGET_ESP32P4
    config BOARD_TYPE_WAVESHARE_ESP32_P4_WIFI6_TOUCH_LCD_8
        bool "Waveshare ESP32-P4-WIFI6-Touch-LCD-8"
        depends on IDF_TARGET_ESP32P4
    config BOARD_TYPE_WAVESHARE_ESP32_P4_WIFI6_TOUCH_LCD_10_1
        bool "Waveshare ESP32-P4-WIFI6-Touch-LCD-10.1"
        depends on IDF_TARGET_ESP32P4
    config BOARD_TYPE_TUDOUZI
        bool "土豆子"
        depends on IDF_TARGET_ESP32S3
    config BOARD_TYPE_LILYGO_T_CIRCLE_S3
        bool "LILYGO T-Circle-S3"
        depends on IDF_TARGET_ESP32S3
    config BOARD_TYPE_LILYGO_T_CAMERAPLUS_S3_V1_0_V1_1
        bool "LILYGO T-CameraPlus-S3_V1_0_V1_1"
        depends on IDF_TARGET_ESP32S3
    config BOARD_TYPE_LILYGO_T_CAMERAPLUS_S3_V1_2
        bool "LILYGO T-CameraPlus-S3_V1_2"
        depends on IDF_TARGET_ESP32S3
    config BOARD_TYPE_LILYGO_T_DISPLAY_S3_PRO_MVSRLORA
        bool "LILYGO T-Display-S3-Pro-MVSRLora"
        depends on IDF_TARGET_ESP32S3
    config BOARD_TYPE_LILYGO_T_DISPLAY_S3_PRO_MVSRLORA_NO_BATTERY
        bool "LILYGO T-Display-S3-Pro-MVSRLora_No_Battery"
        depends on IDF_TARGET_ESP32S3
    config BOARD_TYPE_LILYGO_T_DISPLAY_P4
        bool "LILYGO T-Display-P4"
        depends on IDF_TARGET_ESP32P4
    config BOARD_TYPE_MOVECALL_MOJI_ESP32S3
        bool "Movecall Moji 小智AI衍生版"
        depends on IDF_TARGET_ESP32S3
    config BOARD_TYPE_MOVECALL_MOJI2_ESP32C5
        bool "Movecall Moji2.0 小智AI衍生版"
        depends on IDF_TARGET_ESP32C5
    config BOARD_TYPE_MOVECALL_CUICAN_ESP32S3
        bool "Movecall CuiCan 璀璨·AI吊坠"
        depends on IDF_TARGET_ESP32S3
    config BOARD_TYPE_ATK_DNESP32S3
        bool "正点原子DNESP32S3开发板"
        depends on IDF_TARGET_ESP32S3
    config BOARD_TYPE_ATK_DNESP32S3_BOX
        bool "正点原子DNESP32S3-BOX"
        depends on IDF_TARGET_ESP32S3
    config BOARD_TYPE_ATK_DNESP32S3_BOX0
        bool "正点原子DNESP32S3-BOX0"
        depends on IDF_TARGET_ESP32S3
    config BOARD_TYPE_ATK_DNESP32S3_BOX2_WIFI
        bool "正点原子DNESP32S3-BOX2-WIFI"
        depends on IDF_TARGET_ESP32S3
    config BOARD_TYPE_ATK_DNESP32S3_BOX2_4G
        bool "正点原子DNESP32S3-BOX2-4G"
        depends on IDF_TARGET_ESP32S3
    config BOARD_TYPE_ATK_DNESP32S3M_WIFI
        bool "正点原子DNESP32S3M-WIFI"
        depends on IDF_TARGET_ESP32S3
    config BOARD_TYPE_ATK_DNESP32S3M_4G
        bool "正点原子DNESP32S3M-4G"
        depends on IDF_TARGET_ESP32S3
    config BOARD_TYPE_ATK_DNESP32S3_BOX3
        bool "正点原子DNESP32S3-BOX3"
        depends on IDF_TARGET_ESP32S3
    config BOARD_TYPE_DU_CHATX
        bool "嘟嘟开发板CHATX(wifi)"
        depends on IDF_TARGET_ESP32S3
    config BOARD_TYPE_TAIJI_PI_S3
        bool "太极小派esp32s3"
        depends on IDF_TARGET_ESP32S3
    config BOARD_TYPE_XINGZHI_CUBE_0_85TFT_WIFI
        bool "无名科技星智0.85(WIFI)"
        depends on IDF_TARGET_ESP32S3
    config BOARD_TYPE_XINGZHI_CUBE_0_85TFT_ML307
        bool "无名科技星智0.85(ML307)"
        depends on IDF_TARGET_ESP32S3
    config BOARD_TYPE_XINGZHI_CUBE_0_96OLED_WIFI
        bool "无名科技星智0.96(WIFI)"
        depends on IDF_TARGET_ESP32S3
    config BOARD_TYPE_XINGZHI_CUBE_0_96OLED_ML307
        bool "无名科技星智0.96(ML307)"
        depends on IDF_TARGET_ESP32S3
    config BOARD_TYPE_XINGZHI_CUBE_1_54TFT_WIFI
        bool "无名科技星智1.54(WIFI)"
        depends on IDF_TARGET_ESP32S3
    config BOARD_TYPE_XINGZHI_CUBE_1_54TFT_ML307
        bool "无名科技星智1.54(ML307)"
        depends on IDF_TARGET_ESP32S3
    config BOARD_TYPE_XINGZHI_METAL_1_54_WIFI
        bool "无名科技星智1.54 METAL(wifi)"
        depends on IDF_TARGET_ESP32S3
    config BOARD_TYPE_XINGZHI_ABS_2_0
        bool "无名科技星智ABS 2.0"
        depends on IDF_TARGET_ESP32S3
    config BOARD_TYPE_SEEED_STUDIO_SENSECAP_WATCHER
        bool "Seeed Studio SenseCAP Watcher"
        depends on IDF_TARGET_ESP32S3
    config BOARD_TYPE_DOIT_S3_AIBOX
        bool "四博智联AI陪伴盒子"
        depends on IDF_TARGET_ESP32S3
    config BOARD_TYPE_MIXGO_NOVA
        bool "元控·青春"
        depends on IDF_TARGET_ESP32S3
    config BOARD_TYPE_GENJUTECH_S3_1_54TFT
        bool "亘具科技1.54(s3)"
        depends on IDF_TARGET_ESP32S3
    config BOARD_TYPE_ESP_S3_LCD_EV_Board
        bool "乐鑫ESP S3 LCD EV Board开发板"
        depends on IDF_TARGET_ESP32S3
    config BOARD_TYPE_ESP_S3_LCD_EV_Board_2
        bool "乐鑫ESP S3 LCD EV Board 2开发板"
        depends on IDF_TARGET_ESP32S3
    config BOARD_TYPE_ZHENGCHEN_1_54TFT_WIFI
        bool "征辰科技1.54(WIFI)"
        depends on IDF_TARGET_ESP32S3
    config BOARD_TYPE_ZHENGCHEN_1_54TFT_ML307
        bool "征辰科技1.54(ML307)"
        depends on IDF_TARGET_ESP32S3
    config BOARD_TYPE_ZHENGCHEN_CAM
        bool "征辰科技AI Camera"
        depends on IDF_TARGET_ESP32S3
    config BOARD_TYPE_ZHENGCHEN_CAM_ML307
        bool "征辰科技AI Camera(ML307)"
	depends on IDF_TARGET_ESP32S3
    config BOARD_TYPE_MINSI_K08_DUAL
        bool "敏思科技K08(DUAL)"
        depends on IDF_TARGET_ESP32S3
    config BOARD_TYPE_SPOTPEAR_ESP32_S3_1_54_MUMA
        bool "Spotpear ESP32-S3-1.54-MUMA"
        depends on IDF_TARGET_ESP32S3
    config BOARD_TYPE_SPOTPEAR_ESP32_S3_1_28_BOX
        bool "Spotpear ESP32-S3-1.28-BOX"
        depends on IDF_TARGET_ESP32S3
    config BOARD_TYPE_OTTO_ROBOT
        bool "ottoRobot"
        depends on IDF_TARGET_ESP32S3
    config BOARD_TYPE_ELECTRON_BOT
        bool "electronBot"
        depends on IDF_TARGET_ESP32S3
    config BOARD_TYPE_JIUCHUAN
        bool "九川智能"
        depends on IDF_TARGET_ESP32S3
    config BOARD_TYPE_LABPLUS_MPYTHON_V3
        bool "labplus mpython_v3 board"
        depends on IDF_TARGET_ESP32S3
    config BOARD_TYPE_LABPLUS_LEDONG_V2
        bool "labplus ledong_v2 board"
        depends on IDF_TARGET_ESP32S3
    config BOARD_TYPE_SURFER_C3_1_14TFT
        bool "Surfer-C3-1.14TFT"
        depends on IDF_TARGET_ESP32C3
    config BOARD_TYPE_YUNLIAO_S3
        bool "小智云聊-S3"
        depends on IDF_TARGET_ESP32S3
    config BOARD_TYPE_WIRELESS_TAG_WTP4C5MP07S
        bool "Wireless-Tag WTP4C5MP07S"
        depends on IDF_TARGET_ESP32P4
    config BOARD_TYPE_AIPI_LITE
        bool "AIPI-Lite"
        depends on IDF_TARGET_ESP32S3
    config BOARD_TYPE_HU_087
        bool "HU-087"
        depends on IDF_TARGET_ESP32S3
    config BOARD_TYPE_Freenove_ESP32S3_DISPLAY_2_8_LCD
        bool "Freenove ESP32S3 Display 2.8 LCD"
        depends on IDF_TARGET_ESP32S3
    config BOARD_TYPE_AI_VOX3
        bool "NULLLAB-AI-VOX3"
        depends on IDF_TARGET_ESP32S3
endchoice

choice
    depends on BOARD_TYPE_LILYGO_T_DISPLAY_P4
    prompt "Chọn loại màn hình"
    default SCREEN_TYPE_HI8561
        config SCREEN_TYPE_HI8561
            bool "HI8561"
        config SCREEN_TYPE_RM69A10
            bool "RM69A10"
endchoice

choice
    depends on BOARD_TYPE_LILYGO_T_DISPLAY_P4
    prompt "Chọn định dạng màu màn hình"
    default SCREEN_PIXEL_FORMAT_RGB565
        config SCREEN_PIXEL_FORMAT_RGB565
            bool "RGB565"
        config SCREEN_PIXEL_FORMAT_RGB888
            bool "RGB888"
endchoice

choice ESP_S3_LCD_EV_Board_Version_TYPE
    depends on BOARD_TYPE_ESP_S3_LCD_EV_Board
    prompt "Loại EV_BOARD"
    default ESP_S3_LCD_EV_Board_1p4
    config ESP_S3_LCD_EV_Board_1p4
        bool "乐鑫ESP32_S3_LCD_EV_Board-MB_V1.4"
    config ESP_S3_LCD_EV_Board_1p5
        bool "乐鑫ESP32_S3_LCD_EV_Board-MB_V1.5"
endchoice

choice DISPLAY_OLED_TYPE
    depends on BOARD_TYPE_BREAD_COMPACT_WIFI || BOARD_TYPE_BREAD_COMPACT_ML307 || BOARD_TYPE_BREAD_COMPACT_NT26 || BOARD_TYPE_BREAD_COMPACT_ESP32 || BOARD_TYPE_HU_087
    prompt "Loại màn hình OLED"
    default OLED_SSD1306_128X32
    help
        Loại màn hình OLED đơn sắc
    config OLED_SSD1306_128X32
        bool "SSD1306 128*32"
    config OLED_SSD1306_128X64
        bool "SSD1306 128*64"
    config OLED_SH1106_128X64
        bool "SH1106 128*64"
endchoice

choice DISPLAY_LCD_TYPE
    depends on BOARD_TYPE_BREAD_COMPACT_WIFI_LCD || BOARD_TYPE_BREAD_COMPACT_ESP32_LCD || BOARD_TYPE_CGC || BOARD_TYPE_BREAD_COMPACT_WIFI_CAM
    prompt "Loại màn hình LCD"
    default LCD_ST7789_240X320
    help
        Loại màn hình LCD
    config LCD_ST7789_240X320
        bool "ST7789 240*320, IPS"
    config LCD_ST7789_240X320_NO_IPS
        bool "ST7789 240*320, Non-IPS"
    config LCD_ST7789_170X320
        bool "ST7789 170*320"
    config LCD_ST7789_172X320
        bool "ST7789 172*320"
    config LCD_ST7789_240X280
        bool "ST7789 240*280"
    config LCD_ST7789_240X240
        bool "ST7789 240*240"
    config LCD_ST7789_240X240_7PIN
        bool "ST7789 240*240, 7PIN"
    config LCD_ST7789_240X135
        bool "ST7789 240*135"
    config LCD_ST7735_128X160
        bool "ST7735 128*160"
    config LCD_ST7735_128X128
        bool "ST7735 128*128"
    config LCD_ST7796_320X480
        bool "ST7796 320*480 IPS"
    config LCD_ST7796_320X480_NO_IPS
        bool "ST7796 320*480, Non-IPS"
    config LCD_ILI9341_240X320
        bool "ILI9341 240*320"
    config LCD_ILI9341_240X320_NO_IPS
        bool "ILI9341 240*320, Non-IPS"
    config LCD_GC9A01_240X240
        bool "GC9A01 240*240 Circle"
    config LCD_CUSTOM
        bool "LCD tùy chỉnh (Tham số màn hình tùy chỉnh)"
endchoice

choice DISPLAY_ESP32S3_KORVO2_V3
    depends on BOARD_TYPE_ESP_KORVO2_V3 || BOARD_TYPE_ESP_KORVO2_V3_RNDIS
    prompt "ESP32S3_KORVO2_V3 LCD Type"
    default ESP32S3_KORVO2_V3_LCD_ST7789
    help
        Loại màn hình LCD
    config ESP32S3_KORVO2_V3_LCD_ST7789
        bool "ST7789 240*280"
    config ESP32S3_KORVO2_V3_LCD_ILI9341
        bool "ILI9341 240*320"
endchoice

choice DISPLAY_ESP32S3_CAM_XXXX
    depends on BOARD_TYPE_WAVESHARE_ESP32_S3_CAM_XXXX
    prompt "ESP32S3_CAM LCD Type"
    default BSP_LCD_SIZE_2INCH
    help
        Loại màn hình LCD
    config BSP_LCD_SIZE_2INCH
        bool "Module màn hình LCD cảm ứng 2 inch"

    config BSP_LCD_SIZE_2_8INCH
        bool "Module màn hình LCD cảm ứng 2.8 inch"

    config BSP_LCD_SIZE_3_5INCH
        bool "Module màn hình LCD cảm ứng 3.5 inch"

    config BSP_LCD_SIZE_1_83INCH
        bool "Module màn hình LCD cảm ứng 1.83 inch"
endchoice

choice DISPLAY_ESP32S3_AUDIO_BOARD
    depends on BOARD_TYPE_WAVESHARE_ESP32_S3_AUDIO_BOARD
    prompt "ESP32S3_AUDIO_BOARD LCD Type"
    default AUDIO_BOARD_LCD_JD9853
    help
        Loại màn hình LCD
    config AUDIO_BOARD_LCD_JD9853
        bool "JD9853 320*172"
    config AUDIO_BOARD_LCD_ST7789
        bool "ST7789 240*320"
endchoice

choice DISPLAY_ESP32S3_TOUCH_LCD_1_85C
    depends on BOARD_TYPE_WAVESHARE_ESP32_S3_TOUCH_LCD_1_85C
    prompt "ESP32S3_TOUCH_LCD_1_85C version"
    default VERSION_2_0
    help
        Phiên bản phần cứng
    config VERSION_1_0
        bool "version 1.0"
    config VERSION_2_0
        bool "version 2.0"
endchoice


choice DISPLAY_STYLE
    prompt "Chọn kiểu hiển thị"
    default USE_DEFAULT_MESSAGE_STYLE
    help
        Chọn kiểu hiển thị cho thiết bị Xiaozhi

    config USE_DEFAULT_MESSAGE_STYLE
        bool "Kiểu tin nhắn mặc định"

    config USE_WECHAT_MESSAGE_STYLE
        bool "Kiểu tin nhắn WeChat"

    config USE_EMOTE_MESSAGE_STYLE
        bool "Kiểu hoạt ảnh biểu cảm"
        depends on BOARD_TYPE_ESP_BOX || BOARD_TYPE_ESP_BOX_3 \
            || BOARD_TYPE_ESP_VOCAT || BOARD_TYPE_LICHUANG_DEV_S3 || BOARD_TYPE_RYMCU_BIGSMART \
            || BOARD_TYPE_ESP_SENSAIRSHUTTLE
endchoice

config USE_MULTILINE_CHAT_MESSAGE
    bool "Hiển thị tin nhắn nhiều dòng (chỉ chế độ mặc định)"
    depends on USE_DEFAULT_MESSAGE_STYLE
    default n
    help
        Khi bật, vùng hiển thị tin nhắn trong chế độ mặc định sẽ hiển thị
        nhiều dòng được bọc lại, mở rộng từ dưới lên trên màn hình,
        với chiều cao tự thích nghi.
        Khi tắt (mặc định), hiển thị một dòng cuộn ngang duy nhất
        ở cuối màn hình.

choice WAKE_WORD_TYPE
    prompt "Loại triển khai Wake Word"
    default USE_AFE_WAKE_WORD if (IDF_TARGET_ESP32S3 || IDF_TARGET_ESP32P4) && SPIRAM
    default WAKE_WORD_DISABLED
    help
        Chọn loại triển khai wake word sẽ sử dụng

    config WAKE_WORD_DISABLED
        bool "Tắt"
        help
            Tắt tính năng nhận diện wake word

    config USE_ESP_WAKE_WORD
        bool "Mô hình Wakenet không có AFE"
        depends on IDF_TARGET_ESP32C3 || IDF_TARGET_ESP32C5 || IDF_TARGET_ESP32C6 || (IDF_TARGET_ESP32 && SPIRAM)
        help
            Hỗ trợ ESP32 C3, ESP32 C5 và ESP32 C6, và (ESP32 với PSRAM)

    config USE_AFE_WAKE_WORD
        bool "Mô hình Wakenet với AFE"
        depends on (IDF_TARGET_ESP32S3 || IDF_TARGET_ESP32P4) && SPIRAM
        help
            Hỗ trợ AEC nếu có, yêu cầu ESP32 S3 và PSRAM

    config USE_CUSTOM_WAKE_WORD
        bool "Mô hình Multinet (Wake Word tùy chỉnh)"
        depends on (IDF_TARGET_ESP32S3 || IDF_TARGET_ESP32P4) && SPIRAM
        help
            Yêu cầu ESP32 S3 và PSRAM

endchoice

config CUSTOM_WAKE_WORD
    string "Wake Word tùy chỉnh"
    default "xiao tu dou"
    depends on USE_CUSTOM_WAKE_WORD
    help
        Wake word tùy chỉnh, dùng phiên âm pinyin cho tiếng Trung, phân cách bằng dấu cách

config CUSTOM_WAKE_WORD_DISPLAY
    string "Hiển thị Wake Word tùy chỉnh"
    default "小土豆"
    depends on USE_CUSTOM_WAKE_WORD
    help
        Lời chào gửi đến server sau khi nhận diện được wake word

config CUSTOM_WAKE_WORD_THRESHOLD
    int "Ngưỡng Wake Word tùy chỉnh (%)"
    default 20
    range 1 99
    depends on USE_CUSTOM_WAKE_WORD
    help
        Ngưỡng wake word tùy chỉnh, phạm vi 1-99, giá trị càng nhỏ càng nhạy, mặc định 20

config SEND_WAKE_WORD_DATA
    bool "Gửi dữ liệu Wake Word"
    default y
    depends on USE_AFE_WAKE_WORD || USE_CUSTOM_WAKE_WORD
    help
        Gửi dữ liệu wake word đến server như tin nhắn đầu tiên của cuộc trò chuyện và chờ phản hồi

config WAKE_WORD_DETECTION_IN_LISTENING
    bool "Bật nhận diện Wake Word trong chế độ lắng nghe"
    default n
    depends on USE_AFE_WAKE_WORD || USE_CUSTOM_WAKE_WORD
    help
        Bật nhận diện wake word trong khi đang ở chế độ lắng nghe.
        Khi bật, thiết bị có thể phát hiện wake word trong lúc lắng nghe,
        cho phép ngắt cuộc hội thoại hiện tại.
        Khi tắt (mặc định), nhận diện wake word bị vô hiệu hóa trong lúc lắng nghe.

config USE_AUDIO_PROCESSOR
    bool "Bật khử nhiễu âm thanh"
    default y
    depends on (IDF_TARGET_ESP32S3 || IDF_TARGET_ESP32P4) && SPIRAM
    help
        Yêu cầu ESP32 S3 và PSRAM

config USE_DEVICE_AEC
    bool "Bật AEC phía thiết bị"
    default n
        depends on USE_AUDIO_PROCESSOR && (BOARD_TYPE_ESP_BOX_3 || BOARD_TYPE_ESP_BOX || BOARD_TYPE_ESP_BOX_LITE \
        || BOARD_TYPE_LICHUANG_DEV_S3 || BOARD_TYPE_RYMCU_BIGSMART || BOARD_TYPE_ESP_KORVO2_V3 || BOARD_TYPE_WAVESHARE_ESP32_S3_TOUCH_AMOLED_1_75|| BOARD_TYPE_WAVESHARE_ESP32_S3_TOUCH_AMOLED_1_75C || BOARD_TYPE_WAVESHARE_ESP32_S3_TOUCH_LCD_1_83\
        || BOARD_TYPE_WAVESHARE_ESP32_S3_TOUCH_AMOLED_2_06 || BOARD_TYPE_WAVESHARE_ESP32_S3_TOUCH_LCD_4B || BOARD_TYPE_WAVESHARE_ESP32_P4_WIFI6_TOUCH_LCD_4B || BOARD_TYPE_WAVESHARE_ESP32_P4_WIFI6_TOUCH_LCD_4_3 \
        || BOARD_TYPE_WAVESHARE_ESP32_P4_WIFI6_TOUCH_LCD_7B \
        || BOARD_TYPE_WAVESHARE_ESP32_P4_WIFI6_TOUCH_LCD_3_4C || BOARD_TYPE_WAVESHARE_ESP32_P4_WIFI6_TOUCH_LCD_4C || BOARD_TYPE_ESP_S3_LCD_EV_Board_2 || BOARD_TYPE_YUNLIAO_S3 \
        || BOARD_TYPE_WAVESHARE_ESP32_P4_WIFI6_TOUCH_LCD_7 || BOARD_TYPE_WAVESHARE_ESP32_P4_WIFI6_TOUCH_LCD_8 || BOARD_TYPE_WAVESHARE_ESP32_P4_WIFI6_TOUCH_LCD_10_1 \
        || BOARD_TYPE_ESP_VOCAT || BOARD_TYPE_WAVESHARE_ESP32_S3_TOUCH_LCD_3_49 || BOARD_TYPE_WAVESHARE_ESP32_S3_RLCD_4_2 || BOARD_TYPE_ZHENGCHEN_CAM || BOARD_TYPE_ZHENGCHEN_CAM_ML307 \
        || BOARD_TYPE_WAVESHARE_ESP32_S3_TOUCH_LCD_4_3C || BOARD_TYPE_WAVESHARE_ESP32_S3_TOUCH_LCD_1_54 || BOARD_TYPE_WAVESHARE_ESP32_S3_LCD_0_85 || BOARD_TYPE_AI_VOX3 || BOARD_TYPE_WAVESHARE_ESP32_S3_TOUCH_AMOLED_1_43C)
    help
        Để hoạt động đúng, AEC phía thiết bị yêu cầu đường tham chiếu đầu ra sạch từ tín hiệu loa và cách âm vật lý giữa micro và loa.

config USE_SERVER_AEC
    bool "Bật AEC phía server (Không ổn định)"
    default n
    depends on USE_AUDIO_PROCESSOR
    help
        Để hoạt động đúng, AEC phía server yêu cầu server hỗ trợ tính năng này

config USE_AUDIO_DEBUGGER
    bool "Bật chế độ gỡ lỗi âm thanh"
    default n
    help
        Bật chế độ gỡ lỗi âm thanh, gửi dữ liệu âm thanh qua UDP đến máy chủ

menu "Phương thức cấu hình WiFi"
    help
        Chọn phương thức cấu hình WiFi
    config USE_HOTSPOT_WIFI_PROVISIONING
        bool "Điểm truy cập (Hotspot)"
        default y
        help
            Sử dụng WiFi Hotspot để truyền dữ liệu cấu hình WiFi
    config USE_ACOUSTIC_WIFI_PROVISIONING
        bool "Âm thanh"
        help
            Sử dụng tín hiệu âm thanh để truyền dữ liệu cấu hình WiFi

    config USE_ESP_BLUFI_WIFI_PROVISIONING
        bool "Esp Blufi"
        help
            Sử dụng giao thức ESP BluFi để truyền dữ liệu cấu hình WiFi
        select BT_ENABLED
        select BT_BLE_42_FEATURES_SUPPORTED
        select BT_BLE_BLUFI_ENABLE
        select MBEDTLS_DHM_C
endmenu

config AUDIO_DEBUG_UDP_SERVER
    string "Địa chỉ UDP Server gỡ lỗi âm thanh"
    default "192.168.2.100:8000"
    depends on USE_AUDIO_DEBUGGER
    help
        Địa chỉ UDP server, định dạng: IP:PORT, dùng để nhận dữ liệu gỡ lỗi âm thanh

config RECEIVE_CUSTOM_MESSAGE
    bool "Bật nhận tin nhắn tùy chỉnh"
    default n
    help
        Bật tính năng nhận tin nhắn tùy chỉnh, cho phép thiết bị nhận tin nhắn tùy chỉnh từ server (ưu tiên qua giao thức MQTT)

menu "Cấu hình Camera"
    depends on !IDF_TARGET_ESP32

    comment "Cảnh báo: Vui lòng đọc phần trợ giúp trước khi thay đổi các cài đặt này."

    config XIAOZHI_CAMERA_ALLOW_JPEG_INPUT
        bool "Cho phép đầu vào JPEG"
        default n
        help
            Cho phép định dạng đầu vào JPEG cho camera.

            Tùy chọn này có thể cần bật khi sử dụng camera USB.

            Hiện chưa hỗ trợ khi dùng đồng thời với XIAOZHI_ENABLE_ROTATE_CAMERA_IMAGE.

    config XIAOZHI_ENABLE_HARDWARE_JPEG_ENCODER
        bool "Bật bộ mã hóa JPEG phần cứng"
        default y
        depends on SOC_JPEG_ENCODE_SUPPORTED
        help
            Sử dụng bộ mã hóa JPEG phần cứng trên ESP32-P4 để mã hóa ảnh sang JPEG.
            Xem thêm tại https://docs.espressif.com/projects/esp-idf/en/stable/esp32p4/api-reference/peripherals/jpeg.html

    config XIAOZHI_ENABLE_HARDWARE_JPEG_DECODER
        bool "Bật bộ giải mã JPEG phần cứng"
        default n
        depends on SOC_JPEG_DECODE_SUPPORTED && XIAOZHI_CAMERA_ALLOW_JPEG_INPUT
        help
            Sử dụng bộ giải mã JPEG phần cứng trên ESP32-P4 để giải mã JPEG thành ảnh.
            Xem thêm tại https://docs.espressif.com/projects/esp-idf/en/stable/esp32p4/api-reference/peripherals/jpeg.html

    config XIAOZHI_ENABLE_CAMERA_DEBUG_MODE
        bool "Bật chế độ gỡ lỗi Camera"
        default n
        help
            Bật chế độ gỡ lỗi camera, in thông tin debug camera ra console.
            Chỉ hoạt động trên các bo mạch hỗ trợ camera.

    config XIAOZHI_ENABLE_CAMERA_ENDIANNESS_SWAP
        bool "Bật hoán đổi endianness bộ đệm camera bằng phần mềm"
        default n
        depends on !CAMERA_SENSOR_SWAP_PIXEL_BYTE_ORDER
        help
            Tùy chọn này xử lý bộ đệm camera như một mảng uint16_t[] và thực hiện
            hoán đổi byte (chuyển đổi endianness) trên từng phần tử.

            Chỉ nên được chỉnh sửa bởi kỹ sư tích hợp bo mạch phát triển.

            **Sử dụng sai có thể gây ra màu sắc hình ảnh không chính xác!**

            LƯU Ý: Nếu tùy chọn CAMERA_SENSOR_SWAP_PIXEL_BYTE_ORDER có sẵn cho cảm biến của bạn, hãy ưu tiên dùng tùy chọn đó.

    menuconfig XIAOZHI_ENABLE_ROTATE_CAMERA_IMAGE
        bool "Bật xoay ảnh Camera"
        default n
        depends on !XIAOZHI_CAMERA_ALLOW_JPEG_INPUT
        help
            Bật tính năng xoay ảnh camera về đúng hướng.
            - Trên ESP32-P4, xoay ảnh được xử lý bởi phần cứng PPA.
            - Trên các chip khác, xoay ảnh thực hiện bằng phần mềm và có chi phí hiệu năng.
            - Để xoay 180°, dùng HFlip + VFlip thay vì tùy chọn này.

            Hiện chưa hỗ trợ khi dùng đồng thời với XIAOZHI_CAMERA_ALLOW_JPEG_INPUT.

    if XIAOZHI_ENABLE_ROTATE_CAMERA_IMAGE
        choice XIAOZHI_CAMERA_IMAGE_ROTATION_ANGLE
            prompt "Góc xoay ảnh Camera (theo chiều kim đồng hồ)"
            default XIAOZHI_CAMERA_IMAGE_ROTATION_ANGLE_90
            help
                Góc xoay ảnh camera.
            config XIAOZHI_CAMERA_IMAGE_ROTATION_ANGLE_90
                bool "90°"
            config XIAOZHI_CAMERA_IMAGE_ROTATION_ANGLE_270
                bool "270°"
            comment "Để xoay 180°, dùng HFlip + VFlip thay vì tùy chọn này"
        endchoice
    endif
endmenu

menu "TAIJIPAI_S3_CONFIG"
    depends on BOARD_TYPE_TAIJI_PI_S3
    choice I2S_TYPE_TAIJIPI_S3
        prompt "Loại I2S taiji-pi-S3"
        default TAIJIPAI_I2S_TYPE_STD
        help
            Chọn loại I2S
        config TAIJIPAI_I2S_TYPE_STD
            bool "I2S Type STD"
        config TAIJIPAI_I2S_TYPE_PDM
            bool "I2S Type PDM"
    endchoice

    config I2S_USE_2SLOT
    bool "Bật I2S 2 kênh"
    default y
    help
        Bật chế độ hai kênh âm thanh
endmenu

endmenu
```
